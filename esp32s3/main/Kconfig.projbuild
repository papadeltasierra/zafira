## esp32s3/main/Kconfig.projbuild
```kconfig
menu "Zafira BLE Endpoint"

config ZAFIRA_BLE_DEVICE_NAME
    string "BLE advertised device name"
    default "Zafira"
    help
        Name shown when this ESP32-S3 advertises over BLE.

config ZAFIRA_BLE_PROFILE_UUID
    string "BLE profile UUID (128-bit canonical format)"
    default "99999999-9999-9999-9999-999999999999"
    help
        128-bit UUID used as the custom BLE service identifier.
        Format must match xxxxxxxx-xxxx-xxxx-xxxx-xxxxxxxxxxxx.

config ZAFIRA_BLE_MTU
    int "BLE ATT MTU size (bytes)"
    default 517
    range 23 517
    help
        Preferred ATT MTU negotiated on each connection.
        The peer may agree on a smaller value.
        517 is the ATT maximum and is needed for usable OTA throughput.

config ZAFIRA_OTA_ACK_WINDOW
    int "OTA chunks per acknowledgement"
    default 16
    range 1 64
    help
        Number of OTA data chunks the device accepts before notifying an ACK.
        This is the transfer backpressure window.

config ZAFIRA_OTA_TIMEOUT_S
    int "OTA inactivity timeout (seconds)"
    default 30
    range 5 300
    help
        Abort an in-progress OTA session if no data arrives within this period.

config ZAFIRA_DISPLAY_QUEUE_DEPTH
    int "Display message queue depth"
    default 3
    range 1 32
    help
        Number of received BLE payloads buffered for the display task.
        New payloads are rejected when the queue is full so BLE processing remains nonblocking.

config ZAFIRA_DISPLAY_SDA_GPIO
    int "Display SDA GPIO"
    default 5
    range 0 48
    help
        GPIO connected to the display serial data line.

config ZAFIRA_DISPLAY_SCL_GPIO
    int "Display SCL GPIO"
    default 6
    range 0 48
    help
        GPIO connected to the display serial clock line.

config ZAFIRA_DISPLAY_MRQ_GPIO
    int "Display MRQ GPIO"
    default 7
    range 0 48
    help
        GPIO connected to the display master request line.

endmenu
```

## esp32s3/sdkconfig.defaults
```kconfig
CONFIG_BT_ENABLED=y
CONFIG_BT_NIMBLE_ENABLED=y
CONFIG_BT_CONTROLLER_ENABLED=y
CONFIG_BT_NIMBLE_ROLE_PERIPHERAL=y
CONFIG_BT_NIMBLE_NVS_PERSIST=y
CONFIG_BT_NIMBLE_SVC_GAP_DEVICE_NAME_MAX_LEN=32
CONFIG_NIMBLE_CPP_IDF=n
CONFIG_ZAFIRA_BLE_DEVICE_NAME="Zafira"
CONFIG_ZAFIRA_BLE_PROFILE_UUID="A1234567-1234-1234-1234-A12345678901"
CONFIG_ZAFIRA_BLE_MTU=517
CONFIG_ZAFIRA_DISPLAY_SDA_GPIO=9
CONFIG_ZAFIRA_DISPLAY_SCL_GPIO=8
CONFIG_ZAFIRA_DISPLAY_MRQ_GPIO=7

# OTA over BLE
CONFIG_BT_NIMBLE_ATT_PREFERRED_MTU=517
CONFIG_BT_NIMBLE_MSYS1_BLOCK_COUNT=24
CONFIG_ESPTOOLPY_FLASHSIZE_4MB=y
CONFIG_ESPTOOLPY_FLASHSIZE="4MB"
CONFIG_PARTITION_TABLE_CUSTOM=y
CONFIG_PARTITION_TABLE_CUSTOM_FILENAME="partitions.csv"
CONFIG_BOOTLOADER_APP_ROLLBACK_ENABLE=y
CONFIG_APP_PROJECT_VER_FROM_CONFIG=y
CONFIG_APP_PROJECT_VER="0.0.0"
```
